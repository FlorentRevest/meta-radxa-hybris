## conf/layer.conf
```bitbake
# We have a conf and classes directory, append to BBPATH
BBPATH .= ":${LAYERDIR}"

# We have a recipes directory, add to BBFILES
BBFILES += "${LAYERDIR}/recipes*/*/*.bb ${LAYERDIR}/recipes*/*/*.bbappend"

BBFILE_COLLECTIONS += "radxa-hybris-layer"
BBFILE_PATTERN_radxa-hybris-layer := "^${LAYERDIR}/"
BBFILE_PRIORITY_radxa-hybris-layer = "7"

PREFERRED_PROVIDER_virtual/egl_rk3188-radxarock ?= "libhybris"
PREFERRED_PROVIDER_virtual/libgles1_rk3188-radxarock ?= "libhybris"
PREFERRED_PROVIDER_virtual/libgles2_rk3188-radxarock ?= "libhybris"

PREFERRED_PROVIDER_virtual/android-headers_rk3188-radxarock = "android"
PREFERRED_PROVIDER_virtual/android-system-image_rk3188-radxarock = "android"
PREFERRED_PROVIDER_virtual/kernel_rk3188-radxarock = "linux"
PREFERRED_VERSION_android_rk3188-radxarock = "jellybean"
PREFERRED_VERSION_linux_rk3188-radxarock = "3.0.36+_jellybean"

IMAGE_INSTALL_rk3188-radxarock += "android-tools android-system-compat android-system android"

SERIAL_CONSOLES_rk3188-radxarock = "115200;ttyFIQ0"
```

## conf/machine/radxa-hybris.conf
```bitbake
#@TYPE: Machine
#@NAME: Radxa Rock Hybris
#@DESCRIPTION: Machine configuration for the Radxa Rock board using libhybris for the HW Acceleration

TARGET_ARCH = "arm"
require conf/machine/include/tune-cortexa9.inc

KERNEL_IMAGETYPE = "zImage"

PREFERRED_PROVIDER_virtual/egl ?= "libhybris"
PREFERRED_PROVIDER_virtual/libgles1 ?= "libhybris"
PREFERRED_PROVIDER_virtual/libgles2 ?= "libhybris"
PREFERRED_PROVIDER_virtual/android-headers = "full-android"
PREFERRED_PROVIDER_virtual/android-system-image = "full-android"
PREFERRED_PROVIDER_virtual/kernel = "full-android"
PREFERRED_VERSION_full-android = "3.0.36++jellybean"

MACHINE_FEATURES = "kernel26 mmc mmcroot screen usbgadget wifi keyboard"

SERIAL_CONSOLES = "115200;ttyFIQ0"

IMAGE_CLASSES += "rockchip-update-img"
IMAGE_FSTYPES += "ext4 rockchip-update-img"

IMAGE_INSTALL += " android-tools android-system-compat android-system"
```
